VERSION ""
NS_ :

BU_: LocationECU

BO_ 200 LocationFrame: 8 LocationECU
 SG_ Latitude : 0|32@1+ (1,0) [0|4294967295] ""
 SG_ Longitude : 32|32@1+ (1,0) [0|4294967295] ""
