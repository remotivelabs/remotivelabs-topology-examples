VERSION "1.0"

NS_ :

BU_:
    BCM
    DIM
    FLCM
    RLCM
    GWM

BO_ 100 DaylightRunningLightControl: 1 BCM
  SG_ LeftDaylightRunningLightRequest : 0|1@1+ (1,0) [0|1] ""  DIM, FLCM, RLCM
  SG_ RightDaylightRunningLightRequest : 1|1@1+ (1,0) [0|1] ""  DIM, FLCM, RLCM

BO_ 101 LowBeamLightControl: 1 BCM
  SG_ LeftLowBeamLightRequest : 0|1@1+ (1,0) [0|1] ""  DIM, FLCM, RLCM
  SG_ RightLowBeamLightRequest : 1|1@1+ (1,0) [0|1] ""  DIM, FLCM, RLCM

BO_ 102 HighBeamLightControl: 1 BCM
  SG_ LeftHighBeamLightRequest : 0|1@1+ (1,0) [0|1] ""  DIM, FLCM
  SG_ RightHighBeamLightRequest : 1|1@1+ (1,0) [0|1] ""  DIM, FLCM

BO_ 103 TurnLightControl: 1 BCM
  SG_ LeftTurnLightRequest : 0|1@1+ (1,0) [0|1] ""  DIM, FLCM, RLCM, GWM
  SG_ RightTurnLightRequest : 1|1@1+ (1,0) [0|1] ""  DIM, FLCM, RLCM, GWM

BO_ 104 BrakeLightControl: 1 BCM
  SG_ LeftBrakeLightRequest : 0|1@1+ (1,0) [0|1] ""  DIM, RLCM, GWM
  SG_ RightBrakeLightRequest : 1|1@1+ (1,0) [0|1] ""  DIM, RLCM, GWM

BO_ 106 SteeringWheelInfo: 8 BCM
  SG_ SteeringWheelPosition : 0|14@1+ (0.1,-819.2) [-819.2|819.1] "deg"  ADAS

BO_ 200 LocationFrame: 8 TCU
 SG_ Longitude : 28|28@1- (1E-006,0) [-134.218|134.218] "Deg"  GWM
 SG_ Latitude : 0|28@1- (1E-006,0) [-134.218|134.218] "Deg"  GWM

BO_ 300 HVACControl: 8 GWM
 SG_ LeftTemperature : 0|16@1+ (0.1,0) [16|30] "°C" HVAC
 SG_ RightTemperature : 16|16@1+ (0.1,0) [16|30] "°C" HVAC

VAL_ 100 LeftDaylightRunningLightRequest 0 "Off" 1 "On";
VAL_ 100 RightDaylightRunningLightRequest 0 "Off" 1 "On";

VAL_ 101 LeftLowBeamLightRequest 0 "Off" 1 "On";
VAL_ 101 RightLowBeamLightRequest 0 "Off" 1 "On";

VAL_ 102 LeftHighBeamLightRequest 0 "Off" 1 "On";
VAL_ 102 RightHighBeamLightRequest 0 "Off" 1 "On";

VAL_ 103 LeftTurnLightRequest 0 "Off" 1 "On";
VAL_ 103 RightTurnLightRequest 0 "Off" 1 "On";

VAL_ 104 LeftBrakeLightRequest 0 "Off" 1 "On";
VAL_ 104 RightBrakeLightRequest 0 "Off" 1 "On";

BA_DEF_ BO_ "GenMsgCycleTime" FLOAT 0 10000;

BA_ "GenMsgCycleTime" BO_ 200 200;
BA_ "GenMsgCycleTime" BO_ 100 50;
BA_ "GenMsgCycleTime" BO_ 101 50;
BA_ "GenMsgCycleTime" BO_ 102 50;
BA_ "GenMsgCycleTime" BO_ 103 50;
BA_ "GenMsgCycleTime" BO_ 104 50;
BA_ "GenMsgCycleTime" BO_ 106 50;
BA_ "GenMsgCycleTime" BO_ 300 500;
