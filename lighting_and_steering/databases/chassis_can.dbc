VERSION ""
NS_ :

BO_ 123 UISpeedFrame: 8   ABS_ECU
 SG_ uispeed : 0|16@1+ (0.01,0) [0|250] "km/h" GWM

BA_DEF_ BO_ "GenMsgCycleTime" FLOAT 0 10000;

BA_ "GenMsgCycleTime" BO_ 123 200;
