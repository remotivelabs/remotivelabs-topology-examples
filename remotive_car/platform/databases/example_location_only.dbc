VERSION "1.0"

NS_ :

BU_:
    TCU

BA_DEF_ BO_ "GenMsgCycleTime" FLOAT 0 10000;

BO_ 200 LocationFrame: 8 TCU
 SG_ Longitude : 28|28@1- (1E-006,0) [-134.218|134.218] "Deg"  GWM
 SG_ Latitude : 0|28@1- (1E-006,0) [-134.218|134.218] "Deg"  GWM

BA_ "GenMsgCycleTime" BO_ 200 250;
