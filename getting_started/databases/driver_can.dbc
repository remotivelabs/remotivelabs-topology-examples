VERSION "1.0"

NS_ :

BU_:
    SCCM
    BCM

BO_ 100 HazardLightButton: 1 SCCM
 SG_ HazardLightButton : 0|1@1+ (1,0) [0|1] ""  BCM

VAL_ 100 HazardLightButton 0 "Off" 1 "On";

BA_DEF_ BO_ "GenMsgCycleTime" FLOAT 0 10000;

BA_ "GenMsgCycleTime" BO_ 100 50;
